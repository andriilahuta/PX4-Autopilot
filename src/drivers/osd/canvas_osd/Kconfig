## src/drivers/osd/canvas_osd/Kconfig
```kconfig
menuconfig DRIVERS_OSD_CANVAS_OSD
	bool "canvas_osd"
	default n
	---help---
		Enable support for canvas_osd

menuconfig USER_CANVAS_OSD
	bool "canvas_osd running as userspace module"
	default y
	depends on BOARD_PROTECTED && DRIVERS_OSD_CANVAS_OSD
	---help---
		Put canvas_osd in userspace memory
```

## src/drivers/osd/msp_osd_custom/Kconfig
```kconfig
menuconfig DRIVERS_OSD_MSP_OSD_CUSTOM
	bool "msp_osd_custom"
	default n
	---help---
		Enable support for msp_osd_custom

menuconfig USER_MSP_OSD_CUSTOM
	bool "msp_osd_custom running as userspace module"
	default y
	depends on BOARD_PROTECTED && DRIVERS_OSD_MSP_OSD_CUSTOM
	---help---
		Put msp_osd_custom in userspace memory
```
